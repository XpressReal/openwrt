## target/linux/rtd/files-6.6/arch/arm64/configs/rtd16xxb_defconfig
```kconfig
CONFIG_LOCALVERSION="-yocto-standard"
CONFIG_SYSVIPC=y
CONFIG_NO_HZ=y
CONFIG_HIGH_RES_TIMERS=y
CONFIG_BPF_SYSCALL=y
CONFIG_BPF_JIT=y
CONFIG_PREEMPT=y
CONFIG_IKCONFIG=y
CONFIG_IKCONFIG_PROC=y
CONFIG_CGROUPS=y
CONFIG_BLK_CGROUP=y
CONFIG_CGROUP_SCHED=y
CONFIG_RT_GROUP_SCHED=y
CONFIG_CGROUP_PIDS=y
CONFIG_CGROUP_RDMA=y
CONFIG_CGROUP_CPUACCT=y
CONFIG_CGROUP_BPF=y
CONFIG_USER_NS=y
CONFIG_BLK_DEV_INITRD=y
CONFIG_PROFILING=y
CONFIG_NR_CPUS=4
CONFIG_PM_WAKELOCKS=y
CONFIG_ENERGY_MODEL=y
CONFIG_CPU_FREQ=y
CONFIG_CPU_FREQ_STAT=y
CONFIG_CPUFREQ_DT=y
CONFIG_KPROBES=y
CONFIG_COMPAT_32BIT_TIME=y
CONFIG_MODULES=y
CONFIG_MODULE_FORCE_LOAD=y
CONFIG_MODULE_UNLOAD=y
CONFIG_MODULE_FORCE_UNLOAD=y
CONFIG_CMA=y
CONFIG_CMA_DEBUGFS=y
CONFIG_CMA_AREAS=32
CONFIG_NET=y
CONFIG_PACKET=y
CONFIG_PACKET_DIAG=y
CONFIG_UNIX=y
CONFIG_INET=y
CONFIG_NETFILTER=y
CONFIG_NF_CONNTRACK=m
CONFIG_NF_CONNTRACK_TIMEOUT=y
CONFIG_NF_CONNTRACK_AMANDA=m
CONFIG_NF_CONNTRACK_FTP=m
CONFIG_NF_CONNTRACK_H323=m
CONFIG_NF_CONNTRACK_IRC=m
CONFIG_NF_CONNTRACK_NETBIOS_NS=m
CONFIG_NF_CONNTRACK_PPTP=m
CONFIG_NF_CONNTRACK_SANE=m
CONFIG_NF_CONNTRACK_SIP=m
CONFIG_NF_CONNTRACK_TFTP=m
CONFIG_NF_CT_NETLINK=m
CONFIG_NF_TABLES=y
CONFIG_NF_TABLES_INET=y
CONFIG_NF_TABLES_NETDEV=y
CONFIG_NFT_NUMGEN=m
CONFIG_NFT_CT=m
CONFIG_NFT_FLOW_OFFLOAD=m
CONFIG_NFT_CONNLIMIT=m
CONFIG_NFT_LOG=m
CONFIG_NFT_LIMIT=m
CONFIG_NFT_MASQ=m
CONFIG_NFT_REDIR=m
CONFIG_NFT_NAT=m
CONFIG_NFT_TUNNEL=m
CONFIG_NFT_QUEUE=m
CONFIG_NFT_QUOTA=m
CONFIG_NFT_REJECT=m
CONFIG_NFT_COMPAT=m
CONFIG_NFT_HASH=m
CONFIG_NFT_FIB_INET=y
CONFIG_NFT_SOCKET=m
CONFIG_NFT_OSF=m
CONFIG_NFT_SYNPROXY=m
CONFIG_NF_FLOW_TABLE_INET=m
CONFIG_NF_FLOW_TABLE=m
CONFIG_NETFILTER_XT_TARGET_CLASSIFY=m
CONFIG_NETFILTER_XT_TARGET_CONNMARK=m
CONFIG_NETFILTER_XT_TARGET_CT=m
CONFIG_NETFILTER_XT_TARGET_DSCP=m
CONFIG_NETFILTER_XT_TARGET_LOG=m
CONFIG_NETFILTER_XT_TARGET_MARK=m
CONFIG_NETFILTER_XT_TARGET_NFLOG=m
CONFIG_NETFILTER_XT_TARGET_NFQUEUE=m
CONFIG_NETFILTER_XT_TARGET_TRACE=m
CONFIG_NETFILTER_XT_TARGET_TCPMSS=m
CONFIG_NETFILTER_XT_MATCH_COMMENT=m
CONFIG_NETFILTER_XT_MATCH_CONNBYTES=m
CONFIG_NETFILTER_XT_MATCH_CONNLIMIT=m
CONFIG_NETFILTER_XT_MATCH_CONNMARK=m
CONFIG_NETFILTER_XT_MATCH_CONNTRACK=m
CONFIG_NETFILTER_XT_MATCH_DCCP=m
CONFIG_NETFILTER_XT_MATCH_DSCP=m
CONFIG_NETFILTER_XT_MATCH_ESP=m
CONFIG_NETFILTER_XT_MATCH_HASHLIMIT=m
CONFIG_NETFILTER_XT_MATCH_HELPER=m
CONFIG_NETFILTER_XT_MATCH_LENGTH=m
CONFIG_NETFILTER_XT_MATCH_LIMIT=m
CONFIG_NETFILTER_XT_MATCH_MAC=m
CONFIG_NETFILTER_XT_MATCH_MARK=m
CONFIG_NETFILTER_XT_MATCH_MULTIPORT=m
CONFIG_NETFILTER_XT_MATCH_PKTTYPE=m
CONFIG_NETFILTER_XT_MATCH_QUOTA=m
CONFIG_NETFILTER_XT_MATCH_REALM=m
CONFIG_NETFILTER_XT_MATCH_SCTP=m
CONFIG_NETFILTER_XT_MATCH_STATE=m
CONFIG_NETFILTER_XT_MATCH_STATISTIC=m
CONFIG_NETFILTER_XT_MATCH_STRING=m
CONFIG_NETFILTER_XT_MATCH_TCPMSS=m
CONFIG_NETFILTER_XT_MATCH_U32=m
CONFIG_NFT_FIB_IPV4=y
CONFIG_NF_TABLES_ARP=y
CONFIG_IP_NF_IPTABLES=m
CONFIG_IP_NF_MATCH_AH=m
CONFIG_IP_NF_MATCH_ECN=m
CONFIG_IP_NF_MATCH_RPFILTER=m
CONFIG_IP_NF_MATCH_TTL=m
CONFIG_IP_NF_FILTER=m
CONFIG_IP_NF_TARGET_REJECT=m
CONFIG_IP_NF_TARGET_SYNPROXY=m
CONFIG_IP_NF_NAT=m
CONFIG_IP_NF_TARGET_MASQUERADE=m
CONFIG_IP_NF_TARGET_NETMAP=m
CONFIG_IP_NF_TARGET_REDIRECT=m
CONFIG_IP_NF_MANGLE=m
CONFIG_IP_NF_TARGET_ECN=m
CONFIG_IP_NF_TARGET_TTL=m
CONFIG_IP_NF_RAW=m
CONFIG_IP_NF_ARPTABLES=m
CONFIG_IP_NF_ARPFILTER=m
CONFIG_IP_NF_ARP_MANGLE=m
CONFIG_NFT_FIB_IPV6=y
CONFIG_NET_SCHED=y
CONFIG_CFG80211=y
CONFIG_CFG80211_WEXT=y
CONFIG_MAC80211=y
CONFIG_PCI=y
CONFIG_PCIE_RTD=y
CONFIG_PCIE_RTD_TRANS=y
CONFIG_UEVENT_HELPER=y
CONFIG_DEVTMPFS=y
CONFIG_MTD=y
CONFIG_MTD_CMDLINE_PARTS=y
CONFIG_MTD_BLOCK=y
CONFIG_MTD_SPI_NOR=y
# CONFIG_MTD_SPI_NOR_USE_4K_SECTORS is not set
CONFIG_BLK_DEV_LOOP=y
CONFIG_BLK_DEV_RAM=y
CONFIG_BLK_DEV_NVME=y
CONFIG_NVME_MULTIPATH=y
CONFIG_NVME_TCP=y
CONFIG_BLK_DEV_SD=y
CONFIG_SCSI_DEBUG=m
CONFIG_ATA=y
CONFIG_SATA_AHCI=y
CONFIG_AHCI_RTK=y
# CONFIG_ATA_SFF is not set
CONFIG_NETDEVICES=y
CONFIG_VETH=y
# CONFIG_NET_VENDOR_3COM is not set
# CONFIG_NET_VENDOR_ADAPTEC is not set
# CONFIG_NET_VENDOR_AGERE is not set
# CONFIG_NET_VENDOR_ALACRITECH is not set
# CONFIG_NET_VENDOR_ALTEON is not set
# CONFIG_NET_VENDOR_AMAZON is not set
# CONFIG_NET_VENDOR_AMD is not set
# CONFIG_NET_VENDOR_AQUANTIA is not set
# CONFIG_NET_VENDOR_ARC is not set
# CONFIG_NET_VENDOR_ASIX is not set
# CONFIG_NET_VENDOR_ATHEROS is not set
# CONFIG_NET_VENDOR_BROADCOM is not set
# CONFIG_NET_VENDOR_CADENCE is not set
# CONFIG_NET_VENDOR_CAVIUM is not set
# CONFIG_NET_VENDOR_CHELSIO is not set
# CONFIG_NET_VENDOR_CISCO is not set
# CONFIG_NET_VENDOR_CORTINA is not set
# CONFIG_NET_VENDOR_DAVICOM is not set
# CONFIG_NET_VENDOR_DEC is not set
# CONFIG_NET_VENDOR_DLINK is not set
# CONFIG_NET_VENDOR_EMULEX is not set
# CONFIG_NET_VENDOR_ENGLEDER is not set
# CONFIG_NET_VENDOR_EZCHIP is not set
# CONFIG_NET_VENDOR_FUNGIBLE is not set
# CONFIG_NET_VENDOR_GOOGLE is not set
# CONFIG_NET_VENDOR_HUAWEI is not set
# CONFIG_NET_VENDOR_INTEL is not set
# CONFIG_NET_VENDOR_MARVELL is not set
# CONFIG_NET_VENDOR_MELLANOX is not set
# CONFIG_NET_VENDOR_MICREL is not set
# CONFIG_NET_VENDOR_MICROCHIP is not set
# CONFIG_NET_VENDOR_MICROSEMI is not set
# CONFIG_NET_VENDOR_NI is not set
# CONFIG_NET_VENDOR_NATSEMI is not set
# CONFIG_NET_VENDOR_NETERION is not set
# CONFIG_NET_VENDOR_NETRONOME is not set
# CONFIG_NET_VENDOR_NVIDIA is not set
# CONFIG_NET_VENDOR_OKI is not set
# CONFIG_NET_VENDOR_PACKET_ENGINES is not set
# CONFIG_NET_VENDOR_PENSANDO is not set
# CONFIG_NET_VENDOR_QLOGIC is not set
# CONFIG_NET_VENDOR_BROCADE is not set
# CONFIG_NET_VENDOR_QUALCOMM is not set
# CONFIG_NET_VENDOR_RDC is not set
# CONFIG_NET_VENDOR_RENESAS is not set
# CONFIG_NET_VENDOR_ROCKER is not set
# CONFIG_NET_VENDOR_SAMSUNG is not set
# CONFIG_NET_VENDOR_SEEQ is not set
# CONFIG_NET_VENDOR_SILAN is not set
# CONFIG_NET_VENDOR_SIS is not set
# CONFIG_NET_VENDOR_SOLARFLARE is not set
# CONFIG_NET_VENDOR_SMSC is not set
# CONFIG_NET_VENDOR_SOCIONEXT is not set
# CONFIG_NET_VENDOR_STMICRO is not set
# CONFIG_NET_VENDOR_SUN is not set
# CONFIG_NET_VENDOR_SYNOPSYS is not set
# CONFIG_NET_VENDOR_TEHUTI is not set
# CONFIG_NET_VENDOR_TI is not set
# CONFIG_NET_VENDOR_VERTEXCOM is not set
# CONFIG_NET_VENDOR_VIA is not set
# CONFIG_NET_VENDOR_WANGXUN is not set
# CONFIG_NET_VENDOR_WIZNET is not set
# CONFIG_NET_VENDOR_XILINX is not set
CONFIG_USB_RTL8152=m
CONFIG_SERIAL_8250=y
CONFIG_SERIAL_8250_CONSOLE=y
# CONFIG_SERIAL_8250_PCI is not set
CONFIG_SERIAL_8250_NR_UARTS=3
CONFIG_SERIAL_8250_RUNTIME_UARTS=3
CONFIG_SERIAL_8250_EXTENDED=y
CONFIG_SERIAL_8250_DW=y
# CONFIG_SERIAL_8250_PERICOM is not set
CONFIG_I2C=y
CONFIG_I2C_REALTEK=y
CONFIG_SPI=y
CONFIG_SPI_DESIGNWARE=y
CONFIG_PINCTRL=y
CONFIG_GPIOLIB=y
CONFIG_GPIO_MOCKUP=m
CONFIG_WATCHDOG=y
CONFIG_WATCHDOG_CORE=y
CONFIG_MFD_SYSCON=y
CONFIG_MFD_APW8886_I2C=y
CONFIG_REGULATOR=y
CONFIG_REGULATOR_FIXED_VOLTAGE=y
CONFIG_REGULATOR_APW8886=y
CONFIG_USB=y
CONFIG_USB_OTG=y
CONFIG_USB_XHCI_HCD=y
CONFIG_USB_STORAGE=y
CONFIG_USB_UAS=y
CONFIG_USB_DWC3=y
CONFIG_USB_FTDI_SPI=y
CONFIG_USB_GADGET=y
CONFIG_TYPEC=y
CONFIG_MMC=y
CONFIG_MMC_SDHCI=y
CONFIG_MMC_SDHCI_PLTFM=y
CONFIG_MMC_RTK_SDMMC=y
CONFIG_MMC_CQHCI=y
CONFIG_RTC_CLASS=y
CONFIG_DMADEVICES=y
CONFIG_UIO=y
CONFIG_UIO_PDRV_GENIRQ=y
# CONFIG_VIRTIO_MENU is not set
CONFIG_STAGING=y
CONFIG_HWSPINLOCK=y
# CONFIG_IOMMU_SUPPORT is not set
# CONFIG_RTK_IMAGE_CODEC is not set
CONFIG_REALTEK_CRT=y
# CONFIG_RTK_DEMOD is not set
# CONFIG_RTK_DPI_COORD is not set
CONFIG_RTK_FAN=y
# CONFIG_RTK_PM_HIFI is not set
# CONFIG_RTK_TP is not set
CONFIG_RTK_USB_CTRL_MANAGER=y
# CONFIG_RTK_VCPU is not set
# CONFIG_RTK_VE3_UART is not set
CONFIG_RTK_BSV_CTRL=y
CONFIG_PWM=y
CONFIG_RESET_CONTROLLER=y
CONFIG_RESET_RTK_M2TMX=y
CONFIG_PHY_RTK_RTD_USB2PHY=y
CONFIG_PHY_RTK_RTD_USB3PHY=y
CONFIG_EXT3_FS=y
CONFIG_AUTOFS_FS=y
CONFIG_FSCACHE=y
CONFIG_FSCACHE_STATS=y
CONFIG_CACHEFILES=y
CONFIG_VFAT_FS=y
CONFIG_EXFAT_FS=y
CONFIG_NTFS3_FS=y
CONFIG_TMPFS=y
CONFIG_CONFIGFS_FS=y
CONFIG_SQUASHFS=y
CONFIG_SQUASHFS_XATTR=y
CONFIG_SQUASHFS_LZ4=y
CONFIG_SQUASHFS_LZO=y
CONFIG_SQUASHFS_XZ=y
CONFIG_SQUASHFS_ZSTD=y
CONFIG_NLS_CODEPAGE_437=y
CONFIG_NLS_ISO8859_1=y
CONFIG_CRYPTO_DES=y
CONFIG_CRYPTO_CBC=y
CONFIG_CRYPTO_HMAC=y
CONFIG_CRYPTO_MD5=y
CONFIG_DMA_CMA=y
CONFIG_CMA_SIZE_MBYTES=32
CONFIG_CMA_ALIGNMENT=4
CONFIG_PRINTK_TIME=y
CONFIG_DYNAMIC_DEBUG=y
CONFIG_DEBUG_KERNEL=y
CONFIG_DEBUG_INFO_DWARF_TOOLCHAIN_DEFAULT=y
CONFIG_DEBUG_FS=y
CONFIG_KFENCE=y
CONFIG_KFENCE_SAMPLE_INTERVAL=500
CONFIG_FUNCTION_TRACER=y
```

## target/linux/rtd/files-6.6/drivers/clk/realtek/Kconfig
```kconfig
# SPDX-License-Identifier: GPL-2.0-only
menuconfig COMMON_CLK_REALTEK
	bool "Clock driver for Realtek SoCs"
	depends on ARCH_REALTEK || COMPILE_TEST
	default y

if COMMON_CLK_REALTEK

config RTK_CLK_COMMON
	tristate "Realtek Clock Common"
	select RESET_CONTROLLER

config RTK_CLK_PLL_PSAUD
	bool

config RTK_CLK_PLL_DIF
	bool

config RTK_CLK_PLL_MMC
	bool

config RTK_CLK_DCO
	bool

config RTK_CLK_REGMAP_CLKDET
	bool

config COMMON_CLK_RTD1195
	tristate "RTD1195 Clock Controller"
	select RTK_CLK_COMMON
	default y
	help
	  Support for the clock controller on RTD1195

config COMMON_CLK_RTD1295
	tristate "RTD1295 Clock Controller"
	select RTK_CLK_COMMON
	default y
	help
	  Support for the clock controller on RTD1295

config COMMON_CLK_RTD1395
	tristate "RTD1395 Clock Controller"
	select RTK_CLK_COMMON
	select RTK_CLK_REGMAP_CLKDET
	default y
	help
	  Support for the clock controller on RTD1395

config COMMON_CLK_RTD1619
	tristate "RTD1619 Clock Controller"
	select RTK_CLK_COMMON
	select RTK_CLK_PLL_PSAUD
	select RTK_CLK_PLL_DIF
	select RTK_CLK_PLL_MMC
	select RTK_CLK_REGMAP_CLKDET
	default y
	help
	  Support for the clock controller on RTD1619

config COMMON_CLK_RTD1319
	tristate "RTD1319 Clock Controller"
	select RTK_CLK_COMMON
	select RTK_CLK_PLL_PSAUD
	select RTK_CLK_PLL_DIF
	select RTK_CLK_PLL_MMC
	select RTK_CLK_REGMAP_CLKDET
	default y
	help
	  Support for the clock controller on RTD1319

config COMMON_CLK_RTD1619B
	tristate "RTD1619B Clock Controller"
	select RTK_CLK_COMMON
	select RTK_CLK_PLL_PSAUD
	select RTK_CLK_PLL_DIF
	select RTK_CLK_PLL_MMC
	select RTK_CLK_REGMAP_CLKDET
	select RTK_CLK_DCO
	default y
	help
	  Support for the clock controller on RTD1619B

config COMMON_CLK_RTD1319D
	tristate "RTD1319D Clock Controller"
	select RTK_CLK_COMMON
	select RTK_CLK_PLL_PSAUD
	select RTK_CLK_PLL_DIF
	select RTK_CLK_PLL_MMC
	select RTK_CLK_REGMAP_CLKDET
	select RTK_CLK_DCO
	default y
	help
	  Support for the clock controller on RTD1319D

config COMMON_CLK_REALTEK_TEE
	tristate "Realtek Tee Clock driver"
	depends on REALTEK_TEE
	default y
	help
	  Support to control pll_scpu in TEE.


config RTK_CLK_DET
	tristate "Clock Detection Support"
	default y
	help
	  This enables clock detection support.

endif
```

## target/linux/rtd/files-6.6/drivers/gpu/drm/realtek/Kconfig
```kconfig
config DRM_RTK
	tristate "DRM Support for Realtek SoCs"
	depends on DRM
	select DRM_GEM_CMA_HELPER
	select DRM_KMS_HELPER
	select DRM_GEM_DMA_HELPER
	select DRM_DISPLAY_HELPER
	select DRM_DISPLAY_DP_HELPER
	select DRM_DISPLAY_HDCP_HELPER
	select DRM_DISPLAY_HDMI_HELPER
	select DRM_MIPI_DSI
	help
	  Choose this option if you have a Realtek SoCs.
	  The module will be called realtek-drm
	  This driver provides kernel mode setting and
	  buffer management to userspace.

if DRM_RTK

config RTK_METADATA_AUTOJUDGE
	bool "Realtek specific METADATA buffer auto judgement"
	default n

endif
```

## target/linux/rtd/files-6.6/drivers/media/platform/rtk_tpdemux/Kconfig
```kconfig
config RTK_TPDEMUX
	tristate "Realtek TP FRONTEND DEMUX support"
	depends on PINCTRL && DVB_CORE && I2C
	help
	  This adds support for Realtek tp demux

choice
	prompt "Realtek tpdemux queue size"
	depends on RTK_TPDEMUX
	default RTK_TPDEMUX_QSIZE_1024KB

config RTK_TPDEMUX_QSIZE_512KB
	bool "512kB"

config RTK_TPDEMUX_QSIZE_768KB
	bool "768KB"

config RTK_TPDEMUX_QSIZE_1024KB
	bool "1024KB"

config RTK_TPDEMUX_QSIZE_2048KB
	bool "2048KB"

endchoice
```

## target/linux/rtd/files-6.6/drivers/phy/realtek/Kconfig
```kconfig
# SPDX-License-Identifier: GPL-2.0
#
# Phy drivers for Realtek platforms
#
config PHY_RTD_PCIE
	tristate "Realtek PCIe PHY driver"
	depends on OF
	select GENERIC_PHY
	help
	  Support for PCIe PHY on realtek chipsets.

config PHY_RTK_SATA
	tristate "Realtek SATA PHY driver"
	depends on OF
	select GENERIC_PHY
	help
	  Support for SATA GEN3 PHY on realtek chipsets.

config PHY_RTK_RTD_USB2PHY
	tristate "Realtek RTD USB2 PHY Transceiver Driver"
	depends on USB_SUPPORT
	select GENERIC_PHY
	select USB_PHY
	select USB_COMMON
	help
	  Enable this to support Realtek SoC USB2 phy transceiver.
	  The DHC (digital home center) RTD series SoCs used the Synopsys
	  DWC3 USB IP. This driver will do the PHY initialization
	  of the parameters.

config PHY_RTK_RTD_USB3PHY
	tristate "Realtek RTD USB3 PHY Transceiver Driver"
	depends on USB_SUPPORT
	select GENERIC_PHY
	select USB_PHY
	select USB_COMMON
	help
	  Enable this to support Realtek SoC USB3 phy transceiver.
	  The DHC (digital home center) RTD series SoCs used the Synopsys
	  DWC3 USB IP. This driver will do the PHY initialization
	  of the parameters.
```

## target/linux/rtd/files-6.6/drivers/soc/realtek/Kconfig
```kconfig
# SPDX-License-Identifier: GPL-2.0-only

menu "Realtek SoC drivers"

config RTK_IMAGE_CODEC
	tristate "RTK Image Codec"
	default y

menuconfig RTD13XX_RTK_CODEC
	tristate "Realtek RTD13XX Codec"
	default n
	help
	  Realtek RTD13XX codec support.

	  If unsure, say N.

config RTD13XX_VE1_CODEC
	tristate "RTK Video Engine 1 Codec"
	depends on RTD13XX_RTK_CODEC
	default n

menuconfig RTD13XXD_RTK_CODEC
	tristate "Realtek RTD13XXD Codec"
	default n
	help
	  Realtek RTD13XXD codec support.

	  If unsure, say N.

config RTD13XXD_VE1_CODEC
	tristate "RTK Video Engine 1 Codec"
	depends on RTD13XXD_RTK_CODEC
	default n

menuconfig RTD1325_RTK_CODEC
	tristate "Realtek RTD1325 Codec"
	default n
	help
	  Realtek RTD1325 codec support.

	  If unsure, say N.

config RTD1325_VE1_CODEC
	tristate "RTK Video Engine 1 Codec"
	depends on RTD1325_RTK_CODEC
	default n

menuconfig RTD16XXB_RTK_CODEC
	tristate "Realtek RTD16XXB Codec"
	default n
	help
	  Realtek RTD16XXB codec support.

	  If unsure, say N.

config RTD16XXB_VE1_CODEC
	tristate "RTK Video Engine 1 Codec"
	depends on RTD16XXB_RTK_CODEC
	default n

source "drivers/soc/realtek/common/Kconfig"
source "drivers/soc/realtek/cpudvfs/Kconfig"
source "drivers/soc/realtek/cpuhp/Kconfig"
source "drivers/soc/realtek/gpu/Kconfig"
source "drivers/soc/realtek/tee_mem/Kconfig"

endmenu
```
