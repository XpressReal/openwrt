## target/linux/rtd/files-6.6/drivers/soc/realtek/common/Kconfig
```kconfig
# SPDX-License-Identifier: GPL-2.0-only

config REALTEK_CHIP_INFO
	tristate "Realtek SoC information"
	default y
	select SOC_BUS
	help
	  The Realtek chips information.

config REALTEK_PM
	tristate "Realtek power management driver"
	default y
	help
	  Suspend to RAM and shutdown support.

config REALTEK_CRT
	tristate "Realtek CRT driver"
	default n
	help
	  Realtek CRT driver

config RTK_ACPU_VE1
	bool "Realtek ACPU VE1 Driver"
	help
	   This driver provides ACPU VE1 controls

config RTK_AVCPU_LOG
	tristate "Realtek AVCPU share memory logging system"
	depends on RTK_FW_REMOTEPROC
	default y
	help
	  Enable AVCPU share memory logging read from userspace
	  via device node.

config RTK_BOOTSTATUS
	tristate "Realtek SB2 Boot Status Driver"
	default y
	help
	  Enable this to driver to provides addtional boot information
	  under '/sys/kernel/bootstatus'.

	  If not sure, say Y.

config RTK_CMA_ACCELERATOR
	tristate "Realtek CMA accelerator driver"
	default n
	depends on CMA && PM_SLEEP && ANDROID_VENDOR_HOOKS
	help
	  Choose this option if you wish to improve CMA performance.

config RTK_DBGPROT
	tristate "Realtek Debug Protection Driver"
	help
	  This driver provides Debug Protection infomation.

config RTK_DEMOD
	tristate "Realtek Demod Device Driver"
	default y
	help
	  This driver provides userspace interface of Demod.

config RTK_DPI_COORD
	tristate "Realtek DPI coordinator driver"
	default y
	help
	  This enables Realtek DPI coordinator driver

config RTK_FAN
	tristate "RTK Fan driver"
	default n
	help
	  Realtek Fan driver

config RTK_FSS
	tristate "Realtek FSS Driver"
	default n
	help
	  This enable Realtek FSS generic control interface.
	  If not sure say N.

config RTK_FWDBG
	tristate "Realtek FWDBG driver"
	depends on RPMSG_RTK_RPC
	default y
	help
	  Realtek FW Debug driver

config RTK_GPIO_MANAGER
	tristate "Realtek GPIO Manager driver"
	default y
	help
	  This enables Realtek GPIO manager driver to control gpio default value and suspend/resume state.

config RTK_IFCP_CLIENT
	tristate "Realtek IFCP client driver"
	depends on RTK_IFCP && RTK_IFCP_MBOX
	help
	  Realtek IFCP client driver

config RTK_MEM_REMAP
	tristate "Realtek RPC Memory Remapping"
	default y
	help
	  The driver provides memory remapping for realtek rpc mechanism.

config RTK_NPUPP
	tristate "Realtek NPUPP driver"
	default n
	help
	  This driver utilizes the pre-processing module of NPU (called NPUPP or NPP).

config RTK_PM_ALARM
	tristate "Realtek Alarm Emulation"
	depends on REALTEK_PM
	default y
	help
	  Support for Alarm Emulation

config RTK_PM_HIFI
	tristate "Realtek HIFI PM"
	depends on REALTEK_PM
	default y
	help
	  Support for Realtek HIFI PM

config RTK_REFCLK
	tristate "Realtek Refclk Driver"
	default y
	help
	  The driver provides refclk.

config RTK_SB2_INV
	tristate "Realtek SB2 Invalid Access Detection Driver"
	default y
	help
	  Enable this to show SB2 Invalid Access in kernel log.
	  This is useful for device driver implementation.

	  If not sure, say Y.

config RTK_SMCC
	tristate "Realtek SMCC driver"
	depends on ARCH_REALTEK
	default y
	help
	  Realtek SMCC driver

config RTK_TP
	tristate "Realtek TP Device Driver"
	default y
	help
	  This driver provides PM and userspace driver interface of TP.

config RTK_USB_CTRL_MANAGER
	tristate "RTK Multiple USB Host/Device Controller Manager"
	default y if USB_OHCI_RTK || USB_EHCI_RTK || USB_DWC3_RTK
	help
	  The Realtek chips are Multiple host/peripheral USB controllers.
	  Enable the driver to control clock, reset and usb power gpio.

config RTK_KRPC
	tristate "Realtek Kernel RPC driver"
	depends on RPMSG_RTK_RPC
	default y
	help
	  Realtek Kernel RPC driver

config RTK_VCPU
	tristate "Realtek VCPU driver"
	default y
	help
	  This enables Realtek VCPU driver.

config RTK_VE3_UART
	tristate "Realtek VE3 uart driver"
	default y
	help
	  This enables Realtek VE3 Pseudo Uart driver.

config RTK_GIC_EXT
	tristate "Realtek GIC extension driver"
	help
	  GIC-v3 extension setting for Realtek DHC SoCs.

	  If not sure, say Y.

source "drivers/soc/realtek/common/buflock/Kconfig"
source "drivers/soc/realtek/common/hse/Kconfig"
source "drivers/soc/realtek/common/rtk_pd/Kconfig"
source "drivers/soc/realtek/common/rtk_ps/Kconfig"
source "drivers/soc/realtek/common/rtk_scd/Kconfig"
source "drivers/soc/realtek/common/rtk_sw_sync/Kconfig"
source "drivers/soc/realtek/common/rtk_tee/Kconfig"
```

## target/linux/rtd/files-6.6/drivers/soc/realtek/common/dpi_tee/Kconfig
```kconfig
config RTK_DPI_TEE
	tristate "Realtek DPI TEE driver"
	depends on REALTEK_TEE
	default y
	help
	  This enables Realtek DPI TEE driver
```

## target/linux/rtd/files-6.6/drivers/soc/realtek/common/mcp/Kconfig
```kconfig
config RTK_MCP
	tristate "Realtek MCP driver"
        default n
        help
          Realtek MCP driver
```

## target/linux/rtd/files-6.6/drivers/soc/realtek/common/rtk_ps/Kconfig
```kconfig
config RTK_PS_INFO
	tristate "Realtek process info driver"
	default n
	help
	  This driver provides an interface for querying process information.
```

## target/linux/rtd/files-6.6/drivers/soc/realtek/common/rtk_scd/Kconfig
```kconfig
menu "Smart Crad Interface Support"

config SMARTCARD
	tristate "Smart Card Interface Support"
	select RTK_REFCLK
	default n
	help
	  Say Y here if you want to support smart card on your platform 
	
source "drivers/soc/realtek/common/rtk_scd/core/Kconfig"

source "drivers/soc/realtek/common/rtk_scd/adapter/Kconfig"

endmenu
	
```

## target/linux/rtd/files-6.6/drivers/soc/realtek/common/rtk_scd/adapter/Kconfig
```kconfig
# drivers/Kconfig

config MARS_SMARTCARD_IFD
	tristate "Smart Card Interface for Saturn(1886 only), Darwin, Macarthur & Nike"
	depends on SMARTCARD && (REALTEK_SATURN || REALTEK_DARWIN || REALTEK_MACARTHUR || REALTEK_NIKE)
	default n
	help
	  If you want to use smart card on Saturn, Darwin and Macarthur board, say Y.

config GPIO_SMARTCARD_IFD
	tristate "GPIO Smart Card Interface"
	depends on SMARTCARD && REALTEK_DMP_VENUS
	select REALTEK_PWM
	default n
	help
	  If you want to use gpio based smart card on board, say Y.

config ICAM_SMARTCARD_IFD
	tristate "ICAM Smart Card Interface for Nike"
	depends on SMARTCARD && (REALTEK_NIKE)
	default n
	help
	  If you want to use ICAM smart card interface on Nike platform, say Y.

config SMARTCARD_FAST_HOTPLUG_PROTECTION
	bool "Smart Card Reduce CMDVCC on/off to protect TDA80xx"
	depends on SMARTCARD
	default n
	help
	  If you want to apply smart card fast hotplug protection, say Y.
```

## target/linux/rtd/files-6.6/drivers/soc/realtek/common/rtk_sw_sync/Kconfig
```kconfig
# SPDX-License-Identifier: GPL-2.0-only
config RTK_SW_SYNC
	tristate "Buffer sync for Realtek DHC SoCs"
	default n
	depends on SYNC_FILE
	help
	  A sync object driver that uses a 32bit counter to coordinate
	  synchronization.  Useful when there is no hardware primitive backing
	  the synchronization.

	  WARNING: improper use of this can result in deadlocking kernel
	  drivers from userspace. Intended for test and debug only.
```

## target/linux/rtd/files-6.6/drivers/soc/realtek/common/rtk_tee/Kconfig
```kconfig
# SPDX-License-Identifier: GPL-2.0-only
# Generic Trusted Execution Environment Configuration
menuconfig REALTEK_TEE
	tristate "Realtek TEE driver"
	depends on HAVE_ARM_SMCCC || COMPILE_TEST
	select CRYPTO
	select CRYPTO_SHA1
	select DMA_SHARED_BUFFER
	select GENERIC_ALLOCATOR
	default y
	help
	  This implements a generic interface towards a Trusted Execution
	  Environment (TEE).

if REALTEK_TEE

source "drivers/soc/realtek/common/rtk_tee/optee/Kconfig"

endif
```

## target/linux/rtd/files-6.6/drivers/soc/realtek/common/rtk_tee/optee/Kconfig
```kconfig
# SPDX-License-Identifier: GPL-2.0-only
# OP-TEE Trusted Execution Environment Configuration
config REALTEK_OPTEE
	tristate "Realtek OP-TEE"
	depends on HAVE_ARM_SMCCC
	depends on MMU
	help
	  This implements the OP-TEE Trusted Execution Environment (TEE)
	  driver for Realtek DHC SoCs.

config OPTEE_SHM_NUM_PRIV_PAGES
	int "Private Shared Memory Pages"
	default 1
	depends on REALTEK_OPTEE
	help
	  This sets the number of private shared memory pages to be
	  used by OP-TEE TEE driver.

config OPTEE_MEM_API
	tristate "Realtek DHC SoC memory protection support"
	depends on REALTEK_OPTEE
	default y
	help
	  This implements the Realtek DHC SoC's memory protection mechanism.

config OPTEE_ACL_API
	bool "Realtek ACL function support"
	depends on REALTEK_OPTEE
	default y
	help
	  This implements the Realtek ACL function.
```

## target/linux/rtd/files-6.6/drivers/soc/realtek/cpudvfs/Kconfig
```kconfig
menu "Realtek CPU DVFS Related Drivers"

config RTK_BSV_CTRL
	tristate "Realtek BSV Controller for CPU DVFS"
	depends on COMMON_CLK && REGULATOR
	default n
        help
          This driver provides CPU voltage conversion based on input
	  frequency if BSV OTP is valid. The voltage would be set simultaneously
	  when clk frequency is set.  If not sure, say N.

config RTK_CPU_VOLT_SEL
	tristate "Add OPP prop extn to CPU device"
	depends on PM_OPP
	default y
	help
	  This helps to set OPP prop extn to CPU devices based on additional
	  information for Realtek platform. If not sure, say Y.

config RTK_FSS_SCAN
	tristate "Realtek FSS Scan Driver"
	depends on RTK_FSS
	default n
	help
	  This driver provides control to run fss scan in userspace.
	  a CPU frequency/voltage pair would be set, and the driver would check
	  speed paraments from fss sensor and determine the voltage is suitable
	  to be used or not. If not sure, say N.

config RTK_VSFC_CTRL
	tristate "Realtek VSFC Controller"
	depends on COMMON_CLK && REGULATOR
	default n
	help
	  This enables Realtek VSFC controller with NWC control.
	  If not sure, say N.

endmenu
```

## target/linux/rtd/files-6.6/drivers/soc/realtek/cpuhp/Kconfig
```kconfig
config RTK_CPUHP_QOS
	bool

config RTK_CPUHP_CONTROL
	tristate "Realtek CPU Hotplug Controller"
	select RTK_CPUHP_QOS
	help
	  This enables Realtek CPU Hotplug Controller

config RTK_CPUHP_SYSFS
	tristate "Realtek CPU Hotplug SysFS"
	select RTK_CPUHP_QOS
	help
	  This enables Realtek CPU Hotplug SysFS
```

## target/linux/rtd/files-6.6/drivers/soc/realtek/tee_mem/Kconfig
```kconfig
config OPTEE_MEM_API
        tristate "Realtek DHC SoC memory protection support"
        depends on REALTEK_OPTEE
        default y
        help
          This implements the Realtek DHC SoC's memory protection mechanism.
```

## target/linux/rtd/files-6.6/sound/soc/realtek/Kconfig
```kconfig
config SND_ACPU_AO
	tristate "Realtek AO in ACPU"
	depends on SND_SOC_REALTEK
	select RTK_REFCLK
	default n

config SND_HIFI_AO
	tristate "Realtek AO in HIFI"
	depends on SND_SOC_REALTEK
	select RTK_REFCLK
	default n

config RTK_CACHEABLE_HEADER
	bool "HIFI with cacheable header"
	default n
	help
	  Enable cacheable HIFI header.

config SND_SOC_REALTEK
	tristate "Realtek ALSA Driver"
	select SND_HWDEP
	select SND_RAWMIDI
	select SND_PCM
	select SND_SOC_COMPRESS
	default n

config SND_SOC_REALTEK_NOTIFY
	tristate "Realtek ALSA Notfiy Driver"
	depends on SND_SOC_REALTEK
	default n

config SND_SOC_REALTEK_FL3236
	tristate "REALTEK Feature for fl3236 light driver"
	default n
```
