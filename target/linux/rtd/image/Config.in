## target/linux/rtd/image/Config.in
```kconfig
config RTD_SD_BOOT_PARTSIZE
	int "Boot (SD Card) filesystem partition size (in MB)"
	depends on TARGET_rtd
	default 20
```

## target/linux/rtd/image/yocto.its
```
/dts-v1/;
/ {
    description = "U-Boot fitImage for rtd1619b aarch64 kernel";
    #address-cells = <1>;
    images {
        kernel-1 {
            description = "Linux Kernel";
            data = /incbin/("Image");
            type = "kernel";
            arch = "arm64";
            os = "linux";
            compression = "none";
            load = <0x01200000>;
            entry = <0x01200000>;
            hash-1 {
                algo = "sha256";
            };
        };
        fdt-bleedingedge{
            description = "BleedingEdge";
            data = /incbin/("image-rtd1619b-bleedingedge-4gb.dtb");
            type = "flat_dt";
            arch = "arm64";
            compression = "none";
            load = <0x03000000>;
            hash-1 {
                algo = "sha256";
            };
        };
    };
    configurations {
        default = "rtd1619b-bleedingedge-emmc";
        rtd1619b-bleedingedge-emmc {
            description = "rtd1619b-bleedingedge-emmc";
            kernel = "kernel-1";
            fdt = "fdt-bleedingedge";
            signature-1 {
                algo = "sha256,rsa2048";
                key-name-hint = "kernel";
                sign-images = "fdt", "kernel";
            };
            signature-2 {
                algo = "sha256,rsa2048";
                key-name-hint = "dev";
                sign-images = "fdt", "kernel";
            };
        };
    };
};
```
